## conf/layer.conf
```bitbake
BBPATH .= ":${LAYERDIR}"
BBFILES += "${LAYERDIR}/recipes-*/*/*.bb \
            ${LAYERDIR}/recipes-*/*/*.bbappend"
BBFILE_COLLECTIONS += "boggybrn"
BBFILE_PATTERN_boggybrn = "^${LAYERDIR}/"
BBFILE_PRIORITY_boggybrn = "6"
LAYERVERSION_boggybrn = "1"
LAYERSERIES_COMPAT_boggybrn = "kirkstone"
```
